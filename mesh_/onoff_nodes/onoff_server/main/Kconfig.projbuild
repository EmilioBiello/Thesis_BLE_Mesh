## mesh_/onoff_nodes/onoff_server/main/Kconfig.projbuild
```kconfig
menu "Example Configuration"
    config ESP_WIFI_SSID
            string "WiFi SSID"
            default "FASTWEB-B9088B"
            help
                SSID (network name) for the example to connect to.

        config ESP_WIFI_PASSWORD
            string "WiFi Password"
            default "A1HM7243ZT"
            help
                WiFi password (WPA or WPA2) for the example to use.

        config ESP_MAXIMUM_RETRY
            int "Maximum retry"
            default 5
            help
                Set the Maximum retry to avoid station reconnecting to the AP unlimited when the AP is really inexistent.

    choice BLE_MESH_EXAMPLE_BOARD
        prompt "Board selection for BLE Mesh"
        default BLE_MESH_ESP_WROOM_32
        help
            Select this option to choose the board for BLE Mesh. The default is ESP32-WROOM-32

        config BLE_MESH_ESP_WROOM_32
            bool "ESP32-WROOM-32"

        config BLE_MESH_ESP_WROVER
            bool "ESP32-WROVER"
    endchoice

    config BLE_MESH_PATCH_FOR_SLAB_APP_1_1_0
        bool "Fix bug of Silicon Lab Android App v1.1.0 when reconnection will cause sequence number to recount from 0"
        default y
        help
            It is an ad hoc solution and needs further modifications

endmenu
```

## socket/level_nodes/level_server_udp/main/Kconfig.projbuild
```kconfig
menu "Example Configuration"

    config ESP_WIFI_SSID
        string "WiFi SSID"
        default "Samsung_S10+"
        help
            SSID (network name) for the example to connect to.

    config ESP_WIFI_PASSWORD
        string "WiFi Password"
        default "EmilioBiello..94"
        help
            WiFi password (WPA or WPA2) for the example to use.
            Can be left blank if the network has no security set.

    choice BLE_MESH_EXAMPLE_BOARD
        prompt "Board selection for BLE Mesh"
        default BLE_MESH_ESP_WROOM_32
        help
            Select this option to choose the board for BLE Mesh. The default is ESP32-WROOM-32

        config BLE_MESH_ESP_WROOM_32
            bool "ESP32-WROOM-32"

        config BLE_MESH_ESP_WROVER
            bool "ESP32-WROVER"
    endchoice

    config BLE_MESH_PATCH_FOR_SLAB_APP_1_1_0
        bool "Fix bug of Silicon Lab Android App v1.1.0 when reconnection will cause sequence number to recount from 0"
        default y
        help
            It is an ad hoc solution and needs further modifications

endmenu
```
